void roadStroke(MapPoint a,MapPoint b,float radius,uint16_t color){int x0=max(135,(int)floor(min(a.x,b.x)-radius-1)),x1=min(306,(int)ceil(max(a.x,b.x)+radius+1)),y0=max(36,(int)floor(min(a.y,b.y)-radius-1)),y1=min(173,(int)ceil(max(a.y,b.y)+radius+1));float vx=b.x-a.x,vy=b.y-a.y,len=vx*vx+vy*vy;for(int y=y0;y<=y1;y++)for(int x=x0;x<=x1;x++){float t=len>0?constrain(((x-a.x)*vx+(y-a.y)*vy)/len,0.0f,1.0f):0,dist=hypotf(x-a.x-vx*t,y-a.y-vy*t);int alpha=constrain((int)roundf((radius+.5f-dist)*15),0,15);if(alpha)lcd.drawPixel(x,y,blend565(color,lcd.pixelColor(x,y),alpha));}}
String mapLabel(const char*raw){String name=raw;int p=name.indexOf('(');if(p>=0)name=name.substring(0,p);name.trim();if(textWidth(name.c_str(),12)<=84)return name;String out;const char*c=name.c_str();while(*c){const char*start=c;nextCode(c);String part;while(start<c)part+=*start++;if(textWidth((out+part+"…").c_str(),12)>84)break;out+=part;}return out+"…";}
void mapGrid(){uint16_t grid=blend565(INK,MAP,2);for(int x=150;x<303;x+=22)lcd.drawFastVLine(x,41,129,grid);for(int y=51;y<170;y+=22)lcd.drawFastHLine(140,y,162,grid);}
void travelArrow(float ax,float ay,float ux,float uy){lcd.drawLine(ax-ux*6,ay-uy*6,ax+ux*2,ay+uy*2,RED);lcd.drawLine(ax-ux*6-uy,ay-uy*6+ux,ax+ux*2-uy,ay+uy*2+ux,RED);lcd.fillTriangle(ax+ux*7,ay+uy*7,ax-uy*4,ay+ux*4,ax+uy*4,ay-ux*4,RED);}
void drawDownloadedMap(){markerPainted=false;mapActualRoad=false;lcd.fillRoundRect(134,35,174,140,10,MAP);mapGrid();for(int i=1;i<activeRoad.count;i++)roadStroke(activeRoad.points[i-1],activeRoad.points[i],4,EDGE);for(int i=1;i<activeRoad.count;i++)roadStroke(activeRoad.points[i-1],activeRoad.points[i],2.7,ROAD);
 const int total=activeRoad.stopCount;int chosen[3],labels=0;if(total<=3){for(int i=0;i<total;i++)chosen[labels++]=i;}else{chosen[labels++]=0;chosen[labels++]=(total-1)/2;chosen[labels++]=total-1;}
 struct Box{int x,y,w,h;};Box boxes[3];String names[3];auto overlaps=[](Box a,Box b){return a.x<b.x+b.w+3&&a.x+a.w+3>b.x&&a.y<b.y+b.h+3&&a.y+a.h+3>b.y;};
 for(int i=0;i<labels;i++){int j=chosen[i];names[i]=mapLabel(j==total-1?cfg.stops[cfg.count-1].name:(const char*)stopLabelText+activeRoad.labels[j]);}
 for(int k=labels-1;k>=0;k--){auto point=activeRoad.stops[chosen[k]];int w=textWidth(names[k].c_str(),12);Box best={140,42+k*38,w,12};float bestScore=1e9;for(int y=42;y<=157;y+=14)for(int side=0;side<2;side++){int x=side?point.x-w-15:point.x+15;x=constrain(x,139,305-w);Box b={x,y,w,12};bool ok=true;for(int j=k+1;j<labels;j++)if(overlaps(b,boxes[j]))ok=false;for(int j=0;j<total;j++){auto q=activeRoad.stops[j];if(q.x>=b.x-7&&q.x<=b.x+b.w+7&&q.y>=b.y-7&&q.y<=b.y+b.h+7)ok=false;}if(overlaps(b,Box{285,142,19,28}))ok=false;float dx=point.x-constrain(point.x,b.x,b.x+b.w),dy=point.y-(b.y+6),score=dx*dx+dy*dy;if(ok&&score<bestScore){best=b;bestScore=score;}}boxes[k]=best;}
 // Red travel arrow follows a real segment toward the boarding stop.
 float arrowScore=-1,ax=0,ay=0,ux=0,uy=0;
 for(int i=1;i<activeRoad.count;i++){auto a=activeRoad.points[i-1],b=activeRoad.points[i];float dx=b.x-a.x,dy=b.y-a.y,len=hypotf(dx,dy);if(len<1)continue;for(int side:{-1,1}){float x=(a.x+b.x)/2-dy/len*20*side,y=(a.y+b.y)/2+dx/len*20*side;if(x<147||x>294||y<49||y>159)continue;Box icon={(int)x-8,(int)y-8,16,16};bool free=!overlaps(icon,Box{285,142,19,28});for(int k=0;k<labels;k++)if(overlaps(icon,boxes[k]))free=false;for(int k=0;k<total;k++)if(hypotf(x-activeRoad.stops[k].x,y-activeRoad.stops[k].y)<14)free=false;float score=len-fabs(i-activeRoad.count*.5f)*.1f;if(free&&score>arrowScore){arrowScore=score;ax=x;ay=y;ux=dx/len;uy=dy/len;}}}
 if(arrowScore>=0)travelArrow(ax,ay,ux,uy);
 for(int i=0;i<labels;i++){auto point=activeRoad.stops[chosen[i]];auto b=boxes[i];int x=constrain(point.x,b.x,b.x+b.w),y=constrain(point.y,b.y,b.y+b.h);if(hypotf(x-point.x,y-point.y)>21)lcd.drawLine(point.x,point.y,x,y,0xADB4);}
 for(int i=0;i<total;i++){auto p=activeRoad.stops[i];lcd.fillCircle(p.x,p.y,i==total-1?5:2,i==total-1?RED:INK);}
 textBG=MAP;for(int i=0;i<labels;i++)label(boxes[i].x,boxes[i].y,names[i].c_str(),12,INK,84);label(289,146,"北",12);label(289,158,"↑",12);textBG=BG;lcd.fillRect(134,175,174,27,BG);String caption=String(activeRoad.meters/1000.f,activeRoad.meters>=2999?0:1)+"km · 估算";label(136,185,caption.c_str(),12,INK,171);
 // A crowded map still gets a travel-direction arrow in the caption margin.
 if(arrowScore<0)for(int i=activeRoad.count-1;i>0;i--){float dx=activeRoad.points[i].x-activeRoad.points[i-1].x,dy=activeRoad.points[i].y-activeRoad.points[i-1].y,len=hypotf(dx,dy);if(len>.1f){travelArrow(292,190,dx/len,dy/len);break;}}

}
