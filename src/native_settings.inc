#include "native_input.h"
#include "stop_catalog.h"
#include "route_catalog.h"
// Native settings: all changes are drafts until Save.
enum NativePage { NS_HOME,NS_KEYS,NS_VARIANTS,NS_STOPS,NS_ALERT,NS_LIGHT,NS_WIFI,NS_WAIT };
struct NativeVariant {char destination[100];char bound;int service;};
struct NativeStopRef {char id[17];int seq;};
struct NativeJob {int kind;char route[8];NativeVariant variant;int index;uint32_t token;};
struct NativeDone {int kind,error;uint32_t token;};
NativeVariant nativeVariants[32];NativeStopRef nativeStops[256];Stop nativeSelection[3];
int nativeVariantCount=0,nativeStopCount=0,nativeSelectionCount=0,nativeChoice=0,nativeOffset=0;
Config draft;uint32_t nativeBaseGen=0,nativeToken=0;NativePage nativePage=NS_HOME;
char nativeRoute[8]="92";bool nativeLetters=false,nativeBusy=false,nativePending=false,nativeSaved=false;int letterPage=0;
String nativeMessage;NativeJob nativeQueued;QueueHandle_t nativeJobs,nativeDone;
String nativeStopLabel(const char*id){uint64_t key=strtoull(id,nullptr,16);int l=0,r=stopLabelCount-1;while(l<=r){int m=(l+r)/2;uint64_t value;memcpy_P(&value,&stopLabels[m].id,sizeof(value));if(value==key){uint32_t off=pgm_read_dword(&stopLabels[m].offset);return String((const char*)stopLabelText+off);}if(value<key)l=m+1;else r=m-1;}return String(id);}
String shortStop(String name){int p=name.indexOf('(');if(p>=0)name=name.substring(0,p);name.trim();return name;}
// Small candidate index + live per-variant validation. New route numbers fall
// back to both regular directions; rebuild the index to discover new variants.
bool searchNativeRoutes(const char*route){nativeVariantCount=0;RouteCandidate candidates[32];int count=0;for(int i=0;i<routeCandidateCount;i++){RouteCandidate c;memcpy_P(&c,routeCandidates+i,sizeof(c));if(strcmp(c.route,route))continue;if(count>=32)return false;candidates[count++]=c;}
 if(!count){strlcpy(candidates[0].route,route,7);candidates[0].bound='O';candidates[0].service=1;candidates[1]=candidates[0];candidates[1].bound='I';count=2;}
 bool reached=false;for(int i=0;i<count;i++){auto&c=candidates[i];DynamicJsonDocument d(2048);String dir=c.bound=='O'?"outbound":"inbound";if(!api("route/"+String(route)+"/"+dir+"/"+String(c.service),d))continue;reached=true;JsonObject row=d["data"].as<JsonObject>();if(row.isNull()||String(row["route"]|"")!=route||String(row["bound"]|"")!=String(c.bound)||atoi(row["service_type"]|"0")!=c.service)continue;auto&v=nativeVariants[nativeVariantCount++];v.bound=c.bound;v.service=c.service;strlcpy(v.destination,row["dest_tc"]|"",100);delay(1);}return reached;
}
void nativeWorker(void*){NativeJob job;for(;;){if(xQueueReceive(nativeJobs,&job,portMAX_DELAY)!=pdTRUE)continue;NativeDone done={job.kind,0,job.token};
 if(job.kind==1){if(!searchNativeRoutes(job.route))done.error=1;else if(!nativeVariantCount)done.error=2;}
 else if(job.kind==2){DynamicJsonDocument d(24576);String dir=job.variant.bound=='O'?"outbound":"inbound";nativeStopCount=0;if(!api("route-stop/"+String(job.route)+"/"+dir+"/"+job.variant.service,d))done.error=1;else{for(JsonObject row:d["data"].as<JsonArray>()){if(nativeStopCount>=256){done.error=3;break;}const char*id=row["stop"]|"";int seq=atoi(row["seq"]|"0");if(!validID(id)||seq<1){done.error=1;break;}auto&s=nativeStops[nativeStopCount++];strlcpy(s.id,id,17);s.seq=seq;}std::sort(nativeStops,nativeStops+nativeStopCount,[](const NativeStopRef&a,const NativeStopRef&b){return a.seq<b.seq;});if(!nativeStopCount)done.error=2;}}
 else if(job.kind==3){nativeSelectionCount=0;int first=max(0,job.index-2);for(int i=first;i<=job.index;i++){DynamicJsonDocument d(2048);if(!api("stop/"+String(nativeStops[i].id),d)){done.error=1;break;}JsonObject v=d["data"];if(String(v["stop"]|"")!=nativeStops[i].id){done.error=1;break;}auto&s=nativeSelection[nativeSelectionCount++];strlcpy(s.id,nativeStops[i].id,17);strlcpy(s.name,v["name_tc"]|"",100);s.lat=atof(v["lat"]|"0");s.lng=atof(v["long"]|"0");s.seq=nativeStops[i].seq;}}
 xQueueSend(nativeDone,&done,portMAX_DELAY);}}
void nativeInit(){nativeJobs=xQueueCreate(1,sizeof(NativeJob));nativeDone=xQueueCreate(1,sizeof(NativeDone));xTaskCreatePinnedToCore(nativeWorker,"settings",10240,nullptr,1,nullptr,0);}
void openNative(){draft=cfg;nativeBaseGen=cfg.gen;nativePage=NS_HOME;nativeLetters=false;letterPage=0;nativeSaved=false;nativeMessage="";strlcpy(nativeRoute,cfg.route,8);settings=true;needsDraw=true;}
void startNativeJob(int kind,int index=0){if(nativeBusy||nativePending){nativeMessage="上一個查詢尚未完成，請稍候";needsDraw=true;return;}if(WiFi.status()!=WL_CONNECTED||time(nullptr)<1700000000){nativeMessage="請先連 Wi-Fi，等時間同步";needsDraw=true;return;}nativeQueued={};nativeQueued.kind=kind;nativeQueued.index=index;nativeQueued.token=++nativeToken;strlcpy(nativeQueued.route,nativeRoute,8);if(kind>1)nativeQueued.variant=nativeVariants[nativeChoice];nativePending=true;nativePage=NS_WAIT;nativeMessage="正在讀取九巴資料…";needsDraw=true;}
void pollNative(){if(nativePending&&!requestBusy&&!nativeBusy){if(xQueueSend(nativeJobs,&nativeQueued,0)==pdTRUE){nativePending=false;nativeBusy=true;}}NativeDone done;if(xQueueReceive(nativeDone,&done,0)!=pdTRUE)return;nativeBusy=false;if(done.token!=nativeToken)return;nativeOffset=0;if(done.error){nativeMessage=done.error==2?"找不到路線或車站":"未能讀取，請重試";nativePage=NS_KEYS;}else if(done.kind==1){nativePage=NS_VARIANTS;nativeMessage="";}else if(done.kind==2){nativePage=NS_STOPS;nativeMessage="";}else{draft.count=nativeSelectionCount;for(int i=0;i<draft.count;i++)draft.stops[i]=nativeSelection[i];strlcpy(draft.route,nativeRoute,8);draft.bound=nativeVariants[nativeChoice].bound;draft.service=nativeVariants[nativeChoice].service;strlcpy(draft.destination,nativeVariants[nativeChoice].destination,100);draft.seq=draft.stops[draft.count-1].seq;strlcpy(draft.stop,draft.stops[draft.count-1].id,17);nativeSaved=false;nativePage=NS_HOME;nativeMessage="";}needsDraw=true;}
void nativeButton(int x,int y,int w,int h,const char*t,uint16_t fill=0xEDDF,int size=16){lcd.fillRoundRect(x,y,w,h,8,fill);textBG=fill;centered(x,y+(h-size)/2,w,t,size,fill==INK?BG:INK);textBG=BG;}
void nativeHeader(const char*title){label(105,10,title,20,INK,210);nativeButton(8,3,85,34,"返回",BG,16);}
void saveNative(){if(nativeBaseGen!=cfg.gen){draft=cfg;nativeBaseGen=cfg.gen;nativeMessage="設定已有更新，請再確認";return;}DynamicJsonDocument d(4096);d["route"]=draft.route;d["bound"]=String(draft.bound);d["service"]=draft.service;d["stop"]=draft.stop;d["seq"]=draft.seq;d["destination"]=draft.destination;d["threshold"]=draft.threshold;d["brightness"]=draft.brightness;d["armed"]=draft.armed;JsonArray ss=d.createNestedArray("stops");for(int i=0;i<draft.count;i++){JsonObject s=ss.createNestedObject();s["id"]=draft.stops[i].id;s["name"]=draft.stops[i].name;s["lat"]=draft.stops[i].lat;s["lng"]=draft.stops[i].lng;s["seq"]=draft.stops[i].seq;}if(applyConfig(d,true)){nativeSaved=true;nativeBaseGen=cfg.gen;nativeMessage="";}else nativeMessage="設定未儲存，請再確認";}
void drawSettings(){textBG=BG;lcd.fillScreen(BG);const char*title=nativePage==NS_HOME?"設定":nativePage==NS_KEYS?"輸入路線":nativePage==NS_VARIANTS?"選擇方向":nativePage==NS_STOPS?"選擇上車站":nativePage==NS_ALERT?"到站提醒":nativePage==NS_LIGHT?"屏幕亮度":nativePage==NS_WIFI?"Wi-Fi":"讀取中";nativeHeader(title);
 if(nativePage==NS_HOME){nativeButton(12,47,144,66,"",0xF6B8);nativeButton(165,47,143,66,"",0xEF18);nativeButton(12,122,144,66,"",0xEF18);nativeButton(165,122,143,66,"",0xEF18);textBG=0xF6B8;label(23,55,"路線與車站",12);String summary=String(draft.route)+" · "+shortStop(draft.stops[draft.count-1].name);label(23,78,summary.c_str(),16,INK,124);textBG=0xEF18;label(176,55,"到站提醒",12);String lead="提前 "+String(draft.threshold)+" 分鐘";label(176,78,lead.c_str(),16,INK,124);label(23,130,"屏幕亮度",12);label(23,153,(String(round(draft.brightness*100./255))+"%").c_str(),20);label(176,130,"Wi-Fi",12);label(176,153,WiFi.status()==WL_CONNECTED?"已連線":"未連線",16);textBG=BG;nativeButton(12,201,296,32,nativeSaved?"已儲存":"儲存設定",INK);}
 else if(nativePage==NS_KEYS){lcd.fillRoundRect(100,39,206,31,5,0xFFFE);textBG=0xFFFE;label(110,43,nativeRoute,20);textBG=BG;label(16,43,"路線",16);
 if(!nativeLetters){const char*keys[]={"1","2","3","4","5","6","7","8","9","ABC","0","刪除"};for(int i=0;i<12;i++)nativeButton(12+(i%3)*101,76+(i/3)*30,94,27,keys[i],0xEF18,16);}
 else{for(int i=0;i<12;i++){int letter=letterPage*12+i;char k[2]={(char)('A'+letter),0};if(letter<26)nativeButton(12+(i%4)*76,76+(i/4)*30,70,27,k,0xEF18,16);}const char*last[]={"123","下頁","清除","刪除"};for(int i=0;i<4;i++)nativeButton(12+i*76,166,70,27,last[i],0xEF18,12);}
 nativeButton(12,202,85,31,"清除",0xEF18);nativeButton(105,202,203,31,"搜尋",INK);}
 else if(nativePage==NS_VARIANTS||nativePage==NS_STOPS){int total=nativePage==NS_VARIANTS?nativeVariantCount:nativeStopCount;for(int r=0;r<3;r++){int i=nativeOffset+r;if(i>=total)break;int y=46+r*48;nativeButton(12,y,296,43,"",0xEF18);textBG=0xEF18;if(nativePage==NS_VARIANTS){String v="往 "+String(nativeVariants[i].destination);label(22,y+4,v.c_str(),16,INK,274);label(22,y+24,(String("班次 ")+nativeVariants[i].service).c_str(),12);}else{String v=String(nativeStops[i].seq)+". "+shortStop(nativeStopLabel(nativeStops[i].id));label(22,y+10,v.c_str(),16,INK,274);}textBG=BG;}nativeButton(12,201,80,32,"上一頁",0xEF18,12);centered(99,209,121,(String(nativeOffset/3+1)+" / "+String((total+2)/3)).c_str(),12);nativeButton(228,201,80,32,"下一頁",0xEF18,12);}
 else if(nativePage==NS_ALERT){nativeButton(22,58,48,48,"-",0xEF18,20);bigNumber(String(draft.threshold).c_str(),110,48,100,58);nativeButton(250,58,48,48,"+",0xEF18,20);centered(80,110,160,"分鐘前提醒",16);nativeButton(20,140,280,38,draft.armed?"一次提醒：已開":"一次提醒：已關",0xEF18);nativeButton(12,201,296,32,"完成",INK);}
 else if(nativePage==NS_LIGHT){centered(0,64,320,(String(round(draft.brightness*100./255))+"%").c_str(),39);nativeButton(26,122,60,44,"-",0xEF18,20);nativeButton(234,122,60,44,"+",0xEF18,20);nativeButton(12,201,296,32,"完成",INK);}
 else if(nativePage==NS_WIFI){label(18,49,WiFi.status()==WL_CONNECTED?"Wi-Fi 已連線":"Wi-Fi 未連線",20);label(18,86,"同一 Wi-Fi 開啟：",16);String url="http://"+WiFi.localIP().toString();label(18,112,WiFi.status()==WL_CONNECTED?url.c_str():"USB 接 Mac 開設定頁",16);label(18,145,(String("設定碼：")+pin).c_str(),16);label(18,178,"密碼在手機或 Mac 輸入",12);nativeButton(12,201,296,32,"完成",INK);}
 else{centered(10,92,300,"正在讀取九巴資料",20);centered(10,126,300,"請稍候，返回可取消",16);}
 if(nativeMessage.length()&&nativePage!=NS_WAIT){lcd.fillRect(0,35,320,38,BG);centered(4,43,312,nativeMessage.c_str(),12);}
}
void nativeTouch(int x,int y){needsDraw=true;
 if(y<38&&x<100){if(nativePage==NS_HOME){settings=false;ledcWrite(0,cfg.brightness);}else if(nativePage==NS_WAIT){nativeToken++;nativePending=false;nativePage=NS_KEYS;}else if(nativePage==NS_STOPS)nativePage=NS_VARIANTS;else if(nativePage==NS_VARIANTS)nativePage=NS_KEYS;else nativePage=NS_HOME;nativeMessage="";return;}
 if(nativePage==NS_WAIT)return;nativeMessage="";
 if(nativePage==NS_HOME){if(y>=201){saveNative();return;}if(y>=47&&y<113){if(x<160){strlcpy(nativeRoute,draft.route,8);nativePage=NS_KEYS;}else nativePage=NS_ALERT;}else if(y>=122&&y<188)nativePage=x<160?NS_LIGHT:NS_WIFI;return;}
 if(nativePage==NS_KEYS){if(y>=202){if(x<100)nativeRoute[0]=0;else if(strlen(nativeRoute))startNativeJob(1);return;}if(y<76||y>=196)return;int row=(y-76)/30;if(!nativeLetters){int col=(x-12)/101;if(x<12||col>2||(x-12)%101>=94)return;int idx=row*3+col;if(idx<9)appendRouteKey(nativeRoute,'1'+idx);else if(idx==9){nativeLetters=true;letterPage=0;}else if(idx==10)appendRouteKey(nativeRoute,'0');else eraseRouteKey(nativeRoute);}else{int col=(x-12)/76;if(x<12||col>3||(x-12)%76>=70)return;int idx=row*4+col;if(idx<12){int letter=letterPage*12+idx;if(letter<26)appendRouteKey(nativeRoute,'A'+letter);}else if(idx==12)nativeLetters=false;else if(idx==13)letterPage=(letterPage+1)%3;else if(idx==14)nativeRoute[0]=0;else eraseRouteKey(nativeRoute);}return;}
 if(nativePage==NS_VARIANTS||nativePage==NS_STOPS){int total=nativePage==NS_VARIANTS?nativeVariantCount:nativeStopCount;if(y>=201){if(x<100)nativeOffset=pagePrevious(nativeOffset);else if(x>=220)nativeOffset=pageNext(nativeOffset,total);return;}if(y<46||y>=190)return;int index=nativeOffset+(y-46)/48;if(index>=total)return;if(nativePage==NS_VARIANTS){nativeChoice=index;startNativeJob(2);}else startNativeJob(3,index);return;}
 if(y>=201){nativePage=NS_HOME;return;}
 if(nativePage==NS_ALERT){if(y>=50&&y<116){if(x<90)draft.threshold=max(1,draft.threshold-1);else if(x>=230)draft.threshold=min(60,draft.threshold+1);}else if(y>=140&&y<=178)draft.armed=!draft.armed;nativeSaved=false;}
 if(nativePage==NS_LIGHT&&y>=120&&y<=168){if(x<100)draft.brightness=max(26,draft.brightness-13);else if(x>220)draft.brightness=min(255,draft.brightness+13);ledcWrite(0,draft.brightness);nativeSaved=false;}
}

// USB-only UI test/control. No save shortcut: use the same hit targets as touch.
void nativeDebug(JsonDocument&d){String action=d["action"]|"status";if(action=="open")openNative();else if(action=="close"){nativeToken++;nativePending=false;settings=false;ledcWrite(0,cfg.brightness);needsDraw=true;}else if(action=="touch"&&settings){int x=d["x"]|-1,y=d["y"]|-1;if(x>=0&&x<320&&y>=0&&y<240)nativeTouch(x,y);}DynamicJsonDocument out(700);out["event"]="settings";out["page"]=(int)nativePage;out["open"]=settings;out["busy"]=nativeBusy||nativePending;out["variants"]=nativeVariantCount;out["stops"]=nativeStopCount;out["offset"]=nativeOffset;out["input"]=nativeRoute;out["draftRoute"]=draft.route;out["draftStop"]=draft.stop;out["saved"]=nativeSaved;out["error"]=nativeMessage;serializeJson(out,Serial);Serial.println();}
